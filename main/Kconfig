## main/Kconfig
```kconfig
menu "M5Stack Weather Configuration"

    config WIFI_SSID
        string "WiFi SSID"
        default "myssid"
        help
            SSID (network name) for the example to connect to.

    config WIFI_PASSWORD
        string "WiFi Password"
        default "mypassword"
        help
            WiFi password (WPA or WPA2) for the example to use.

    config MAXIMUM_RETRY
        int "Maximum retry"
        default 10
        help
            Set the Maximum retry to avoid station reconnecting to the AP unlimited when the AP is really inexistent.

endmenu
```

## sdkconfig.defaults
```kconfig
CONFIG_ESP32_DEFAULT_CPU_FREQ_240=y
CONFIG_ESP32S2_DEFAULT_CPU_FREQ_240=y
CONFIG_ESP32S3_DEFAULT_CPU_FREQ_240=y

CONFIG_FREERTOS_HZ=1000
CONFIG_ESPTOOLPY_BAUD_OTHER_VAL=115200
CONFIG_ESPTOOLPY_FLASHMODE="dio"
CONFIG_ESPTOOLPY_FLASHFREQ_80M=y
CONFIG_ESPTOOLPY_FLASHFREQ="80m"
CONFIG_ESPTOOLPY_FLASHSIZE_16MB=y
CONFIG_ESPTOOLPY_FLASHSIZE="16MB"
CONFIG_ESPTOOLPY_FLASHSIZE_DETECT=y
CONFIG_ESPTOOLPY_BEFORE_RESET=y
CONFIG_ESPTOOLPY_BEFORE="default_reset"
CONFIG_ESPTOOLPY_AFTER_RESET=y
CONFIG_ESPTOOLPY_AFTER="hard_reset"
CONFIG_ESPTOOLPY_MONITOR_BAUD_OTHER_VAL=115200
CONFIG_ESPTOOLPY_MONITOR_BAUD=115200

CONFIG_PARTITION_TABLE_CUSTOM=y
CONFIG_PARTITION_TABLE_CUSTOM_FILENAME="partitions-16MiB.csv"
CONFIG_PARTITION_TABLE_FILENAME="partitions-16MiB.csv"
CONFIG_PARTITION_TABLE_OFFSET=0x10000
CONFIG_PARTITION_TABLE_MD5=y

CONFIG_ESP32_SPIRAM_SUPPORT=y
CONFIG_ESP32S2_SPIRAM_SUPPORT=y
CONFIG_ESP32S3_SPIRAM_SUPPORT=y
CONFIG_SPIRAM_SPEED_80M=y
CONFIG_SPIRAM_MEMTEST=y
CONFIG_SPIRAM_USE_CAPS_ALLOC=y
CONFIG_SPIRAM_TRY_ALLOCATE_WIFI_LWIP=y
CONFIG_SPIRAM_ALLOW_BSS_SEG_EXTERNAL_MEMORY=y
CONFIG_SPIRAM_CACHE_WORKAROUND=y

CONFIG_ESP32_WIFI_IRAM_OPT=y
CONFIG_ESP32_WIFI_RX_IRAM_OPT=y

CONFIG_AXP192_DCDC13_LDO23_CONTROL_BIT6_SELECTED=y
CONFIG_AXP192_DCDC13_LDO23_CONTROL_BIT4_SELECTED=y
CONFIG_AXP192_DCDC13_LDO23_CONTROL_BIT2_SELECTED=y
CONFIG_AXP192_DCDC13_LDO23_CONTROL_BIT1_SELECTED=y
CONFIG_AXP192_DCDC13_LDO23_CONTROL_BIT0_SELECTED=y
CONFIG_AXP192_EXTEN_DCDC2_CONTROL_BIT2=0x04
CONFIG_AXP192_EXTEN_DCDC2_CONTROL_BIT0=0x01
CONFIG_AXP192_DCDC13_LDO23_CONTROL_BIT6=0x40
CONFIG_AXP192_DCDC13_LDO23_CONTROL_BIT4=0x10
CONFIG_AXP192_DCDC13_LDO23_CONTROL_BIT3=0x00
CONFIG_AXP192_DCDC13_LDO23_CONTROL_BIT2=0x04
CONFIG_AXP192_GPIO0_CONTROL_BIT20=0x07
CONFIG_AXP192_DCDC13_LDO23_CONTROL_BIT1=0x02
CONFIG_AXP192_DCDC13_LDO23_CONTROL_BIT0=0x01
CONFIG_AXP192_GPIO0_LDOIO0_VOLTAGE_BIT74=0x00
CONFIG_AXP192_LDO23_VOLTAGE_BIT74=0x00
CONFIG_AXP192_LDO23_VOLTAGE_BIT30=0x00
CONFIG_AXP192_DCDC1_VOLTAGE_BIT60=0x68
CONFIG_AXP192_DCDC3_VOLTAGE_BIT60=0x54
CONFIG_AXP192_LDO23_VOLTAGE_BIT74_3V3=y
CONFIG_AXP192_LDO23_VOLTAGE_BIT30_2V0=y
CONFIG_AXP192_DCDC1_VOLTAGE_BIT60_3V3=y
CONFIG_AXP192_DCDC3_VOLTAGE_BIT60_2V8=y
CONFIG_AXP192_ADC_ENABLE_1_BIT7_SELECTED=y
CONFIG_AXP192_ADC_ENABLE_1_BIT6_SELECTED=y
CONFIG_AXP192_ADC_ENABLE_1_BIT5_SELECTED=y
CONFIG_AXP192_ADC_ENABLE_1_BIT4_SELECTED=y
CONFIG_AXP192_ADC_ENABLE_1_BIT3_SELECTED=y
CONFIG_AXP192_ADC_ENABLE_1_BIT2_SELECTED=y
CONFIG_AXP192_ADC_ENABLE_1_BIT1_SELECTED=y
CONFIG_AXP192_ADC_ENABLE_1_BIT0_SELECTED=y
CONFIG_AXP192_ADC_ENABLE_1_BIT7=0x80
CONFIG_AXP192_ADC_ENABLE_1_BIT6=0x40
CONFIG_AXP192_ADC_ENABLE_1_BIT5=0x20
CONFIG_AXP192_ADC_ENABLE_1_BIT4=0x10
CONFIG_AXP192_ADC_ENABLE_1_BIT3=0x08
CONFIG_AXP192_ADC_ENABLE_1_BIT2=0x04
CONFIG_AXP192_ADC_ENABLE_1_BIT1=0x02
CONFIG_AXP192_ADC_ENABLE_1_BIT0=0x01
CONFIG_AXP192_CHARGE_CONTROL_1_BIT7_SELECTED=y
CONFIG_AXP192_CHARGE_CONTROL_1_BIT7=0x80
CONFIG_AXP192_CHARGE_CONTROL_1_BIT65=0x40
CONFIG_AXP192_CHARGE_CONTROL_1_BIT30=0x00
CONFIG_AXP192_CHARGE_CONTROL_1_BIT4=0x10
CONFIG_AXP192_CHARGE_CONTROL_1_BIT65_42_SELECTED=y
CONFIG_AXP192_CHARGE_CONTROL_1_BIT30_100_SELECTED=y
CONFIG_AXP192_CHARGE_CONTROL_1_BIT4_15_SELECTED=y
CONFIG_AXP192_BATTERY_CHARGE_CONTROL_BIT7=0x00
CONFIG_AXP192_BATTERY_CHARGE_CONTROL_BIT65=0x00
CONFIG_AXP192_BATTERY_CHARGE_CONTROL_BIT10=0x00
CONFIG_AXP192_GPIO1_CONTROL_BIT20_NMOS_SELECTED=y
CONFIG_AXP192_GPIO1_CONTROL_BIT20=0x00
CONFIG_AXP192_GPIO2_CONTROL_BIT20_NMOS_SELECTED=y
CONFIG_AXP192_GPIO2_CONTROL_BIT20=0x00
CONFIG_AXP192_GPIO43_FUNCTION_CONTROL_BIT10_NMOS_SELECTED=y
CONFIG_AXP192_GPIO43_FUNCTION_CONTROL_BIT10=0x01
CONFIG_AXP192_GPIO43_FUNCTION_CONTROL_BIT32_NMOS_SELECTED=y
CONFIG_AXP192_GPIO43_FUNCTION_CONTROL_BIT32=0x04
CONFIG_AXP192_GPIO43_FUNCTION_CONTROL_BIT7=0x80

CONFIG_HAVE_I2C_MANAGER=y
CONFIG_I2C_MANAGER_0_ENABLED=y
CONFIG_I2C_MANAGER_0_SDA=21
CONFIG_I2C_MANAGER_0_SCL=22
CONFIG_I2C_MANAGER_0_FREQ_HZ=400000
CONFIG_I2C_MANAGER_0_TIMEOUT=20
CONFIG_I2C_MANAGER_0_LOCK_TIMEOUT=50
CONFIG_I2C_MANAGER_0_PULLUPS=y
CONFIG_I2C_MANAGER_1_ENABLED=y
CONFIG_I2C_MANAGER_1_SDA=32
CONFIG_I2C_MANAGER_1_SCL=33
CONFIG_I2C_MANAGER_1_FREQ_HZ=4000000
CONFIG_I2C_MANAGER_1_TIMEOUT=20
CONFIG_I2C_MANAGER_1_LOCK_TIMEOUT=50
CONFIG_I2C_MANAGER_1_PULLUPS=y
CONFIG_I2C_MANAGER_I2CDEV=y


CONFIG_LV_ATTRIBUTE_FAST_MEM_USE_IRAM=y
CONFIG_LV_CONF_SKIP=y

CONFIG_LV_COLOR_DEPTH_16=y
CONFIG_LV_COLOR_DEPTH=16
CONFIG_LV_COLOR_16_SWAP=y
CONFIG_LV_COLOR_CHROMA_KEY_HEX=0x00FF00
CONFIG_LV_MEM_SIZE_KILOBYTES=32
CONFIG_LV_MEMCPY_MEMSET_STD=y
CONFIG_LV_DISP_DEF_REFR_PERIOD=20
CONFIG_LV_INDEV_DEF_READ_PERIOD=30
CONFIG_LV_DPI_DEF=130
CONFIG_LV_DRAW_COMPLEX=y
CONFIG_LV_SHADOW_CACHE_SIZE=0
CONFIG_LV_IMG_CACHE_DEF_SIZE=0
CONFIG_LV_DISP_ROT_MAX_BUF=10240
CONFIG_LV_USE_ASSERT_NULL=y
CONFIG_LV_USE_ASSERT_MALLOC=y
CONFIG_LV_USE_USER_DATA=y
CONFIG_LV_FONT_MONTSERRAT_12=y
CONFIG_LV_FONT_MONTSERRAT_14=y
CONFIG_LV_FONT_MONTSERRAT_16=y
CONFIG_LV_FONT_MONTSERRAT_18=y
CONFIG_LV_FONT_MONTSERRAT_20=y
CONFIG_LV_FONT_DEFAULT_MONTSERRAT_16=y
CONFIG_LV_USE_THEME_DEFAULT=y
CONFIG_LV_THEME_DEFAULT_DARK=y
CONFIG_LV_THEME_DEFAULT_GROW=y
CONFIG_LV_THEME_DEFAULT_TRANSITION_TIME=80
CONFIG_LV_USE_THEME_BASIC=y
CONFIG_LV_TXT_ENC_UTF8=y
CONFIG_LV_TXT_BREAK_CHARS=" ,.;:-_"
CONFIG_LV_TXT_LINE_BREAK_LONG_LEN=0
CONFIG_LV_TXT_COLOR_CMD="#"
CONFIG_LV_USE_ARC=y
CONFIG_LV_USE_BAR=y
CONFIG_LV_USE_BTN=y
CONFIG_LV_USE_BTNMATRIX=y
CONFIG_LV_USE_CANVAS=y
CONFIG_LV_USE_CHECKBOX=y
CONFIG_LV_USE_CHART=y
CONFIG_LV_USE_DROPDOWN=y
CONFIG_LV_USE_IMG=y
CONFIG_LV_USE_LABEL=y
CONFIG_LV_USE_LINE=y
CONFIG_LV_USE_METER=y
CONFIG_LV_USE_ROLLER=y
CONFIG_LV_ROLLER_INF_PAGES=7
CONFIG_LV_USE_SLIDER=y
CONFIG_LV_USE_SWITCH=y
CONFIG_LV_USE_TEXTAREA=y
CONFIG_LV_TEXTAREA_DEF_PWN_SHOW_TIME=1500
CONFIG_LV_USE_TABLE=y
CONFIG_LV_USE_ANIMIMG=y
CONFIG_LV_USE_CALENDAR=y
CONFIG_LV_CALENDAR_WEEK_STARTS_MONDAY=y
CONFIG_LV_USE_CALENDAR_HEADER_ARROW=y
CONFIG_LV_USE_CALENDAR_HEADER_DROPDOWN=y
CONFIG_LV_USE_COLORWHEEL=y
CONFIG_LV_USE_IMGBTN=y
CONFIG_LV_USE_KEYBOARD=y
CONFIG_LV_USE_LED=y
CONFIG_LV_USE_LIST=y
CONFIG_LV_USE_MSGBOX=y
CONFIG_LV_USE_SPINBOX=y
CONFIG_LV_USE_SPINNER=y
CONFIG_LV_USE_TABVIEW=y
CONFIG_LV_USE_TILEVIEW=y
CONFIG_LV_USE_WIN=y
CONFIG_LV_USE_SPAN=y
CONFIG_LV_USE_FLEX=y
CONFIG_LV_USE_GRID=y
CONFIG_LV_PREDEFINED_DISPLAY_M5CORE2=y
CONFIG_LV_TFT_DISPLAY_CONTROLLER_ILI9341=y
CONFIG_LV_TFT_DISPLAY_PROTOCOL_SPI=y
CONFIG_LV_DISPLAY_ORIENTATION_PORTRAIT=y
CONFIG_LV_DISPLAY_ORIENTATION=0
CONFIG_CUSTOM_DISPLAY_BUFFER_SIZE=y
CONFIG_CUSTOM_DISPLAY_BUFFER_BYTES=12800
CONFIG_LV_TFT_DISPLAY_SPI_HSPI=y
CONFIG_LV_TFT_DISPLAY_SPI_TRANS_MODE_SIO=y
CONFIG_LV_TFT_DISPLAY_SPI_HALF_DUPLEX=y
CONFIG_LV_TFT_USE_CUSTOM_SPI_CLK_DIVIDER=y
CONFIG_LV_TFT_SPI_CLK_DIVIDER_2=y
CONFIG_LV_TFT_CUSTOM_SPI_CLK_DIVIDER=2
CONFIG_LV_INVERT_COLORS=y
CONFIG_LV_DISP_SPI_MOSI=23
CONFIG_LV_DISPLAY_USE_SPI_MISO=y
CONFIG_LV_DISP_SPI_MISO=38
CONFIG_LV_DISP_SPI_INPUT_DELAY_NS=0
CONFIG_LV_DISP_SPI_CLK=18
CONFIG_LV_DISPLAY_USE_SPI_CS=y
CONFIG_LV_DISP_SPI_CS=5
CONFIG_LV_DISPLAY_USE_DC=y
CONFIG_LV_DISP_PIN_DC=15
CONFIG_LV_DISP_PIN_BUSY=35
CONFIG_LV_DISP_BACKLIGHT_OFF=y
CONFIG_LV_I2C=y
CONFIG_LV_I2C_DISPLAY_PORT=0
CONFIG_LV_TOUCH_CONTROLLER=2
CONFIG_LV_TOUCH_CONTROLLER_FT6X06=y
CONFIG_LV_I2C_TOUCH=y
CONFIG_LV_I2C_TOUCH_PORT_0=y
CONFIG_LV_I2C_TOUCH_PORT=0

CONFIG_LANGUAGE_ENGLISH=y

CONFIG_COMPILER_OPTIMIZATION_PERF=y
CONFIG_COMPILER_OPTIMIZATION_ASSERTIONS_ENABLE=y
CONFIG_COMPILER_STACK_CHECK_MODE_NONE=y
```
